## modules/zmk-ble-midi/Kconfig
```kconfig
config ZMK_BLE_MIDI
    bool "Bluetooth LE MIDI service and MIDI key behaviors"
    default y
    depends on ZMK_BLE && (!ZMK_SPLIT || ZMK_SPLIT_ROLE_CENTRAL)
    help
      Adds the standard BLE-MIDI GATT service next to ZMK's HID service, so a
      host (iPad, Mac) can use the keyboard as a Bluetooth MIDI controller
      while it keeps working as a keyboard. Also provides the &midi_note,
      &midi_cc, &midi_cc_tog and &midi_ctl behaviors and the midi_xy input
      processor (trackpad -> two CCs).

if ZMK_BLE_MIDI

config ZMK_BLE_MIDI_QUEUE_SIZE
    int "Outgoing MIDI message queue length"
    default 32

config ZMK_BLE_MIDI_THREAD_STACK_SIZE
    int "Stack size of the MIDI send work queue"
    default 1024

config ZMK_BLE_MIDI_THREAD_PRIORITY
    int "Priority of the MIDI send work queue"
    default 5

config ZMK_BLE_MIDI_DEFAULT_VELOCITY
    int "Note-on velocity at boot (1-127)"
    range 1 127
    default 100

config ZMK_BLE_MIDI_PAIR_ADV_SECONDS
    int "How long MIDI_PAIR advertises the MIDI service, in seconds"
    default 60

config ZMK_BLE_MIDI_XY_INTERVAL_MS
    int "Minimum interval between trackpad CC updates, in milliseconds"
    default 10

endif
```

## modules/zmk-ble-midi/dts/bindings/behaviors/zmk,behavior-midi.yaml
```yaml
description: MIDI key behavior (notes, CCs, performance controls) sent over BLE-MIDI

compatible: "zmk,behavior-midi"

include: one_param.yaml

properties:
  midi-type:
    type: string
    required: true
    enum:
      - "note"       # param: MIDI note; note on while held, off on release
      - "cc"         # param: CC number; 127 while held, 0 on release
      - "cc-toggle"  # param: CC number; alternates 127 / 0 on each press
      - "control"    # param: MIDI_* command from dt-bindings/zmk/midi.h
```

## modules/zmk-ble-midi/dts/bindings/input_processors/zmk,input-processor-midi-jog.yaml
```yaml
description: |
  Trackpad as a DJ jog wheel for scratching: touch = platter touch note,
  left/right = relative jog CC, both for the scratch deck (MIDI_SCRATCH_D1/D2).

compatible: "zmk,input-processor-midi-jog"

include: ip_zero_param.yaml

properties:
  channel:
    type: int
    default: 16
    description: MIDI channel 1-16.
  jog-cc:
    type: array
    default: [20, 21]
    description: Jog CC for deck 1 and deck 2.
  touch-note:
    type: array
    default: [20, 52]
    description: Platter-touch note for deck 1 and deck 2.
  divisor:
    type: int
    default: 1
    description: Trackpad movement units per jog step. Higher = slower, finer scratching.
  invert:
    type: boolean
    description: Flip direction if sliding right moves the record backward.
  encoding:
    type: string
    default: "offset64"
    enum:
      - "offset64"
      - "twos-complement"
    description: Relative CC encoding the DJ app expects for the jog wheel.
```

## modules/zmk-ble-midi/dts/bindings/input_processors/zmk,input-processor-midi-xy.yaml
```yaml
description: |
  Trackpad as a MIDI controller. One finger: X/Y drive two CCs (param1 = X CC,
  param2 = Y CC). Two fingers up/down: note velocity slider. Pinch: a third CC.

compatible: "zmk,input-processor-midi-xy"

include: ip_two_param.yaml

properties:
  channel:
    type: int
    default: 0
    description: MIDI channel 1-16 for everything this sends; 0 = the current channel.
  wheel-cc:
    type: int
    default: -1
    description: Two-finger up/down sends this CC instead of acting as the velocity slider. -1 = velocity slider.
  divisor:
    type: int
    default: 4
    description: One-finger movement units per CC step. Higher = finer, more travel.
  velocity-divisor:
    type: int
    default: 2
    description: Two-finger scroll units per velocity (or wheel-cc) step.
  velocity-invert:
    type: boolean
    description: Flip the velocity slider if moving fingers up makes notes quieter.
  pinch-cc:
    type: int
    default: 18
    description: CC sent by pinching (spread = up). -1 turns pinch off.
  pinch-divisor:
    type: int
    default: 2
    description: Pinch units per CC step.
```

## modules/zmk-ble-midi/dts/bindings/zmk,ble-midi-layers.yaml
```yaml
description: Marks keymap layers as MIDI layers (used to show MIDI status on a display)

compatible: "zmk,ble-midi-layers"

properties:
  layers:
    type: array
    required: true
  half-layers:
    type: array
    description: Layers whose notes follow half-octave shifts (MIDI_HALF keys).
  scratch-layers:
    type: array
    description: Layers (also listed in layers) where the display shows the scratch deck.
```
